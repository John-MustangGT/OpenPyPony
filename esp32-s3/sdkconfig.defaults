## esp32-s3/sdkconfig.defaults
```kconfig
# OpenPonyLogger ESP32-S3 SDK Configuration Defaults

# Flash size configuration for 4MB (actual hardware)
CONFIG_ESPTOOLPY_FLASHSIZE_4MB=y
CONFIG_ESPTOOLPY_FLASHSIZE="4MB"

# Partition table
CONFIG_PARTITION_TABLE_CUSTOM=y
CONFIG_PARTITION_TABLE_CUSTOM_FILENAME="partitions.csv"
CONFIG_PARTITION_TABLE_FILENAME="partitions.csv"

# FreeRTOS
CONFIG_FREERTOS_HZ=1000

# SPIFFS configuration
CONFIG_SPIFFS_MAX_PARTITIONS=3

# Compiler optimizations
CONFIG_COMPILER_OPTIMIZATION_PERF=y

# C++ exceptions support
CONFIG_COMPILER_CXX_EXCEPTIONS=y
CONFIG_COMPILER_CXX_RTTI=y

# PSRAM configuration (2MB PSRAM - ESP32-S3 Reverse TFT Feather)
CONFIG_ESP32S3_SPIRAM_SUPPORT=y
CONFIG_SPIRAM=y
CONFIG_SPIRAM_MODE_QUAD=y
CONFIG_SPIRAM_TYPE_ESPPSRAM16=y
CONFIG_SPIRAM_SIZE=2097152
```
